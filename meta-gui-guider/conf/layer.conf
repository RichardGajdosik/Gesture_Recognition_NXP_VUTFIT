## meta-gui-guider/conf/layer.conf
```bitbake
# We have a conf and classes directory, append to BBPATH
BBPATH .= ":${LAYERDIR}"

# We have a recipes directory, add to BBFILES
BBFILES += "${LAYERDIR}/recipes-*/*/*.bb ${LAYERDIR}/recipes-*/*/*.bbappend"

BBFILE_COLLECTIONS += "guiguider-layer"
BBFILE_PATTERN_guiguider-layer := "^${LAYERDIR}/"

# Define the priority for recipes (.bb files) from this layer,
# choosing carefully how this layer interacts with all of the
# other layers.
BBFILE_PRIORITY_guiguider-layer = "6"

# This should only be incremented on significant changes that will
# cause compatibility issues with other layers
LAYERVERSION_guiguider-layer = "1"

LAYERDEPENDS_guiguider-layer = "core"

LAYERSERIES_COMPAT_guiguider-layer = "langdale mickledore"

LICENSE_PATH += "${LAYERDIR}/licenses"
```
